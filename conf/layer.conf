## conf/layer.conf
```bitbake
# meta-simpleota layer configuration file
# Copyright (c) 2025 Technoculture Research
# SPDX-License-Identifier: MIT

# We have a conf and classes directory, add to BBPATH
BBPATH .= ":${LAYERDIR}"

# We have recipes-* directories, add to BBFILES
BBFILES += "${LAYERDIR}/recipes-*/*/*.bb \
            ${LAYERDIR}/recipes-*/*/*.bbappend"

BBFILE_COLLECTIONS += "meta-simpleota"
BBFILE_PATTERN_meta-simpleota = "^${LAYERDIR}/"
BBFILE_PRIORITY_meta-simpleota = "10"

LAYERDEPENDS_meta-simpleota = "core openembedded-layer meta-python"
LAYERSERIES_COMPAT_meta-simpleota = "dunfell kirkstone langdale mickledore nanbield"

# Add recipe-specific configuration
PREFERRED_VERSION_python3-zenoh ?= "0.10.1"
```
